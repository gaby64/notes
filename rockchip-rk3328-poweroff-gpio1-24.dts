// dtc -I dts -O dtb -f rockchip-rk3328-poweroff-gpio1-24.dts -o /boot/dtb/rockchip/overlay/rockchip-rk3328-poweroff-gpio1-24.dtbo
// Add item rockchip-rk3328-poweroff-gpio1-24 to "overlays=" line in /boot/uEnv.txt

/dts-v1/;
/plugin/;

/ {
	compatible = "rockchip,rk3328";

	fragment@0 {
		target-path = "/";
		__overlay__ {
			gpio-poweroff {
				compatible = "gpio-poweroff";
				gpios = <&gpio1 24 0>;
				timeout-ms = <20000>;
				force-mode;
				export;
			};
		};
	};
};

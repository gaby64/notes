// dtc -I dts -O dtb -f rk3328-poweroff-gpio1-24.dts -o /boot/dtb/rockchip/overlay/rk3328-poweroff-gpio1-24.dtbo
// Add item rk3328-poweroff-gpio1-24 to "overlays=" line in /boot/uEnv.txt

/dts-v1/;
/plugin/;

/ {
	compatible = "rockchip,rk3328";

	fragment@0 {
		target-path = "/";
		__overlay__ {
			gpio-poweroff {
				compatible = "gpio-poweroff";
				/* Sets poweroff pin to GPIOAO_9 as an example. Modify as needed. */
				gpios = <&gpio1 24 0>;
				timeout-ms = <20000>;
				force;
			};
		};
	};
};
